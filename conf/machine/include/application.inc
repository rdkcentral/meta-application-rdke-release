## conf/machine/include/application.inc
```bitbake
# To support layered ipk generation

# See release note for configuration details.
RDK_ARTIFACTS_BASE_URL ?= ""

APPLICATION_EXTENSION = "-application"

# Application IPK configuration

APPLICATION_LAYER_VERSION = "6.0.0"
APPLICATION_LAYER_ARCH = "${MACHINE}${APPLICATION_EXTENSION}"
PACKAGE_EXTRA_ARCHS:append = " ${APPLICATION_LAYER_ARCH}"
OPKG_ARCH_PRIORITY:${APPLICATION_LAYER_ARCH} = "155"

APPLICATION_IPK_PATH ?= "${APPLICATION_LAYER_ARCH}/${APPLICATION_LAYER_VERSION}/ipks/${BUILD_VARIANT}"
APPLICATION_IPK_SERVER_PATH ?= "${RDK_ARTIFACTS_BASE_URL}/${APPLICATION_IPK_PATH}"

# To set the remote feeds
IPK_FEED_URIS += " \
                ${APPLICATION_LAYER_ARCH}##${APPLICATION_IPK_SERVER_PATH} "

# Application OSS IPK configuration

OSS_LAYER_VERSION = "4.10.0"
APPLICATION_OSS = "${@get_oss_arch(d)}${APPLICATION_EXTENSION}"
PACKAGE_EXTRA_ARCHS:append = "${@ '' if '${APPLICATION_OSS}' == '${OSS_LAYER_ARCH}' else ' ${APPLICATION_OSS}'}"
OPKG_ARCH_PRIORITY:${APPLICATION_OSS} = "200"

APPLICATION_OSS_IPK_PATH ?= "${APPLICATION_OSS}/${OSS_LAYER_VERSION}/ipks/"
APPLICATION_OSS_IPK_SERVER_PATH ?= "${RDK_ARTIFACTS_BASE_URL}/${APPLICATION_OSS_IPK_PATH}"

# To set the remote feeds
IPK_FEED_URIS += " \
                ${APPLICATION_OSS}##${APPLICATION_OSS_IPK_SERVER_PATH} "
```
