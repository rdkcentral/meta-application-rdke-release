## conf/layer.conf
```bitbake
# Generic RDKE Application Release layer
BBPATH .= ":${LAYERDIR}"

BBFILE_COLLECTIONS += "application-release"
BBFILE_PATTERN_application-release = "^${LAYERDIR}/"
BBFILE_PRIORITY_application-release = "6"

LAYERDEPENDS_application-release = "core"
LAYERSERIES_COMPAT_application-release = "kirkstone"
```
